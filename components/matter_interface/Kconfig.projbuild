## components/matter_interface/Kconfig.projbuild
```kconfig
menu "Matter Manager Configuration"

    config MATTER_REPORT_MAX_INTERVAL_S
        int "Max reporting interval (s)"
        range 10 3600
        default 180
        help
            Maximal interval in seconds between reportings.

    config MATTER_BATTERY_WARNING_PERCENT
        int "Battery warning level (%)"
        range 0 100
        default 20
        help
            Power Source BatChargeLevel turns Warning at or below this battery percentage.

    config MATTER_BATTERY_CRITICAL_PERCENT
        int "Battery critical level (%)"
        range 0 100
        default 10
        help
            Power Source BatChargeLevel turns Critical at or below this battery percentage.

endmenu
```

## components/sensors_manager/Kconfig.projbuild
```kconfig
menu "Sensors Configuration"

    config SENSORS_I2C_PORT
        int "I2C Port Number"
        range 0 1
        default 0
        help
            I2C port number used to communicate with I2C sensors.

    config SENSORS_I2C_SDA_GPIO
        int "I2C SDA GPIO Number"
        default 22
        help
            GPIO pin for I2C SDA line (GPIO 22 corresponds to pin D4 on Seeed Studio XIAO ESP32C6).

    config SENSORS_I2C_SCL_GPIO
        int "I2C SCL GPIO Number"
        default 23
        help
            GPIO pin for I2C SCL line (GPIO 23 corresponds to pin D5 on Seeed Studio XIAO ESP32C6).


    config VL53L1X_FULL_DISTANCE_MM
        int "VL53L1X distance when full (mm)"
        range 0 4000
        default 30
        help
            Distance from the VL53L1X to the top of the consumable (e.g. a salt block) when it is
            full: reported as 100% remaining. The sensor's specified minimum range is 40 mm;
            closer readings are less reliable. This is the default only: a Matter ResetCondition
            (Home Assistant "Reset filter condition" button) takes the current distance as the
            new full point and keeps it in NVS.

    config VL53L1X_LEVEL_HEIGHT_MM
        int "VL53L1X level height, full to empty (mm)"
        range 1 4000
        default 290
        help
            How much farther the target is when empty (e.g. the salt block height): the distance
            FULL_DISTANCE + LEVEL_HEIGHT is reported as 0% remaining.

    config LD2410S_ENABLED
        bool "Probe for an HLK-LD2410S presence radar"
        default y
        help
            Probes the UART below at boot (about 1 s without a radar) and claims its pins.

    config LD2410S_UART_PORT
        int "LD2410S UART port"
        depends on LD2410S_ENABLED
        range 0 2
        default 1
        help
            UART used for the HLK-LD2410S presence radar (115200 8N1). Keep it off the console UART.

    config LD2410S_TX_GPIO
        int "LD2410S: ESP TX GPIO (to the module's RX)"
        depends on LD2410S_ENABLED
        default 16
        help
            GPIO 16 is pin D6 (TX) on the Seeed Studio XIAO ESP32C6. It is also UART0's default
            TX pin, so the console must not be on UART0 (sdkconfig.defaults.esp32c6 moves it to
            USB Serial/JTAG).

    config LD2410S_RX_GPIO
        int "LD2410S: ESP RX GPIO (from the module's TX/OT1)"
        depends on LD2410S_ENABLED
        default 17
        help
            GPIO 17 is pin D7 (RX) on the Seeed Studio XIAO ESP32C6, also UART0's default RX pin
            (see LD2410S_TX_GPIO).

endmenu
```

## components/status_led/Kconfig.projbuild
```kconfig
menu "Status LED Configuration"

    config STATUS_LED_GPIO
        int "Status LED GPIO Number (-1 to disable)"
        range -1 30
        default 15
        help
            GPIO pin for the status / identify LED (GPIO 15 is the onboard yellow User LED on Seeed Studio XIAO ESP32C6).
            Set to -1 to disable the status LED.

    config STATUS_LED_ACTIVE_LOW
        bool "Status LED is Active-Low"
        depends on STATUS_LED_GPIO >= 0
        default y
        help
            Enable if the status LED turns on when GPIO is driven low (0), such as on Seeed Studio XIAO ESP32C6.

endmenu
```

## main/Kconfig.projbuild
```kconfig
menu "Application Configuration"

    config SENSOR_READ_DELAY_MS
        int "Sensor Read Interval (ms)"
        range 1000 3600000
        default 10000
        help
            Delay in milliseconds between consecutive sensor readings.

    config XIAO_RF_SWITCH
        bool "Power the XIAO ESP32-C6 antenna RF switch"
        depends on IDF_TARGET_ESP32C6
        default y
        help
            Drives GPIO3 low to power the board's RF switch, and GPIO14 to select the antenna.
            Unpowered, the switch passes only a weak signal (short range).

    config XIAO_EXTERNAL_ANTENNA
        bool "Use the external U.FL antenna"
        depends on XIAO_RF_SWITCH
        default n
        help
            Off: the built-in ceramic antenna.

endmenu
```
